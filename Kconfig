## Kconfig
```kconfig
menu "ZMK Per-Key Underglow"

menuconfig ZMK_PK_UNDERGLOW
	bool "ZMK Per-Key Underglow"
	select LED_STRIP
	select SPI
	help
	  Enable support for per-key and per-layer RGB underglow.
	  This acts as a replacement for standard ZMK RGB Underglow.

config ZMK_PK_UNDERGLOW_LAYER
	bool "Enable ZMK Per-Key Underglow Layer feature"
	depends on ZMK_PK_UNDERGLOW
	default y

config ZMK_PK_UNDERGLOW_EXT_POWER
	bool "ZMK_PK_UNDERGLOW_EXT_POWER"
	default n

config ZMK_PK_UNDERGLOW_AUTO_OFF_USB
	bool "ZMK_PK_UNDERGLOW_AUTO_OFF_USB"
	default n

config ZMK_PK_UNDERGLOW_AUTO_OFF_IDLE
	bool "ZMK_PK_UNDERGLOW_AUTO_OFF_IDLE"
	default n

config ZMK_PK_UNDERGLOW_ON_START
	bool "ZMK_PK_UNDERGLOW_ON_START"
	default n

config ZMK_PK_UNDERGLOW_BRT_STEP
	int "ZMK_PK_UNDERGLOW_BRT_STEP"
	default 10

config ZMK_PK_UNDERGLOW_BRT_MIN
	int "ZMK_PK_UNDERGLOW_BRT_MIN"
	default 0

config ZMK_PK_UNDERGLOW_BRT_MAX
	int "ZMK_PK_UNDERGLOW_BRT_MAX"
	default 100

config ZMK_PK_UNDERGLOW_BRT_START
	int "ZMK_PK_UNDERGLOW_BRT_START"
	default 100

config ZMK_PK_UNDERGLOW_HUE_STEP
	int "ZMK_PK_UNDERGLOW_HUE_STEP"
	default 10

config ZMK_PK_UNDERGLOW_HUE_START
	int "ZMK_PK_UNDERGLOW_HUE_START"
	default 0

config ZMK_PK_UNDERGLOW_SAT_STEP
	int "ZMK_PK_UNDERGLOW_SAT_STEP"
	default 10

config ZMK_PK_UNDERGLOW_SAT_START
	int "ZMK_PK_UNDERGLOW_SAT_START"
	default 100

config ZMK_PK_UNDERGLOW_WHITE_SATURATION
	int "White effect saturation level"
	range -1 100
	default -1
	help
	  Saturation level for the UNDERGLOW_EFFECT_WHITE effect (0-100).
	  Overrides devicetree configuration if set.

config ZMK_PK_UNDERGLOW_TWINKLE_MAX
	int "ZMK_PK_UNDERGLOW_TWINKLE_MAX"
	default 5
	help
	  Maximum number of concurrent twinkling stars for the UNDERGLOW_EFFECT_TWINKLE effect.

config ZMK_PK_UNDERGLOW_AMBIENT_BRIGHTNESS
	int "ZMK_PK_UNDERGLOW_AMBIENT_BRIGHTNESS"
	range 0 100
	default 5
	help
	  The background brightness percentage (0-100) for reactive effects like Ripple and Twinkle.

config ZMK_PK_UNDERGLOW_SPD_START
	int "ZMK_PK_UNDERGLOW_SPD_START"
	default 3

config ZMK_PK_UNDERGLOW_EFF_START
	int "ZMK_PK_UNDERGLOW_EFF_START"
	default 0

endmenu
```

## dts/bindings/behaviors/zmk,behavior-pk-underglow-battery.yaml
```yaml
description: Set underglow color based on battery level

compatible: "zmk,behavior-pk-underglow-battery"

include: two_param.yaml

properties:
  threshold:
    type: int
```

## dts/bindings/behaviors/zmk,behavior-pk-underglow-color.yaml
```yaml
description: Set underglow to specified color

compatible: "zmk,behavior-pk-underglow-color"

include: one_param.yaml
```

## dts/bindings/behaviors/zmk,behavior-pk-underglow-eff-bt.yaml
```yaml
# Copyright (c) 2024 The ZMK Contributors
# SPDX-License-Identifier: MIT

description: "Underglow Bluetooth State effect"

compatible: "zmk,behavior-pk-underglow-eff-bt"

include: one_param.yaml
```

## dts/bindings/behaviors/zmk,behavior-pk-underglow-eff-hue.yaml
```yaml
# Copyright (c) 2024 The ZMK Contributors
# SPDX-License-Identifier: MIT

description: Underglow dynamic effect hue color behavior

compatible: "zmk,behavior-pk-underglow-eff-hue"

include: one_param.yaml
```

## dts/bindings/behaviors/zmk,behavior-pk-underglow-eff-usb.yaml
```yaml
description: "PK Underglow USB effect behavior"
compatible: "zmk,behavior-pk-underglow-eff-usb"
include: zero_param.yaml
```

## dts/bindings/behaviors/zmk,behavior-pk-underglow-indicators.yaml
```yaml
description: Set underglow for HID indicators

compatible: "zmk,behavior-pk-underglow-indicators"

include: two_param.yaml

properties:
  indicator:
    type: int
    default: 0
```

## dts/bindings/behaviors/zmk,behavior-pk-underglow-sync.yaml
```yaml
# Copyright (c) 2024 The ZMK Contributors
# SPDX-License-Identifier: MIT

description: PK underglow sync command
compatible: "zmk,behavior-pk-underglow-sync"
properties:
    "#binding-cells":
        type: int
        const: 0
    display-name:
        type: string
        description: Human readable name for ZMK Studio
```

## dts/bindings/behaviors/zmk,behavior-pk-underglow-ug-pairing-digit.yaml
```yaml
description: "PK Underglow Pairing Digit Indicator"

compatible: "zmk,behavior-pk-underglow-ug-pairing-digit"

include: two_param.yaml
```

## dts/bindings/behaviors/zmk,behavior-pk-underglow-ug-pairing-enter.yaml
```yaml
description: "PK Underglow Pairing Enter Indicator"

compatible: "zmk,behavior-pk-underglow-ug-pairing-enter"

include: two_param.yaml
```

## dts/bindings/zmk,pk-underglow-layer.yaml
```yaml
description: |
  Allows defining a rgbmap composed of multiple layers

compatible: "zmk,pk-underglow-layer"

properties:
  pixel-lookup:
    type: array
    required: true
  columns:
    type: int
    required: true
    description: "The number of visual columns across the keyboard matrix."
  rows:
    type: int
    required: true
    description: "The number of visual rows across the keyboard matrix."
  center-column:
    type: int
    required: false
    description: "The visual column index to use as the center origin for radial effects like ripple and pinwheel. Defaults to the physical edge of the board."
  center-row:
    type: int
    required: false
    description: "The visual row index to use as the center origin for radial effects like ripple and pinwheel. Defaults to the physical edge of the board."
  power-gpios:
    type: phandle-array
    required: false
    description: GPIO to toggle power for the underglow LEDs.
  white-saturation:
    type: int
    required: false
    description: "Saturation level for the white effect (0-100)"
  power-stabilization-ms:
    type: int
    required: false
    default: 20
    description: "Delay in ms to allow the power circuit to stabilize before sending LED data."
  sync-delay-ms:
    type: int
    required: false
    default: 500
    description: "Initial sync delay in ms for the peripheral when connecting."
  sync-retry-ms:
    type: int
    required: false
    default: 1000
    description: "Interval in ms between sync retries to the peripheral."
  wake-sync-delay-ms:
    type: int
    required: false
    default: 100
    description: "Delay in ms before syncing the peripheral after the central wakes up."
  fps:
    type: int
    required: false
    default: 20
    description: "The frame rate (frames per second) of the underglow animations. Can be overridden by CONFIG_ZMK_PK_UNDERGLOW_FPS if set."
child-binding:
  description: "A layer to be used in a rgbmap"

  properties:
    bindings:
      type: phandle-array
      required: true
    layer-id:
      type: array
      required: true
    animated:
      type: boolean
      required: false
    fade-delay:
      type: int
      required: false
      default: -1
```
